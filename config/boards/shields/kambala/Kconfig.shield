## config/boards/shields/kambala/Kconfig.shield
```kconfig
# Copyright (c) 2020 Pete Johanson
# SPDX-License-Identifier: MIT

config SHIELD_KAMBALA_LEFT
    def_bool $(shields_list_contains,kambala_left)

config SHIELD_KAMBALA_RIGHT
    def_bool $(shields_list_contains,kambala_right)
```
